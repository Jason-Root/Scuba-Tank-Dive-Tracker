/*
   Heltec E-Paper Kit (E290 / ESP32-C3)
   Main Dive Display + Battery Screen on Button Wake
   Supports Horizontal & Vertical Layouts
*/

#include <WiFi.h>
#include <WiFiClientSecure.h>
#include <HTTPClient.h>
#include <HTTPUpdate.h>
#include <ArduinoOTA.h>
#include <ArduinoJson.h>
#include <Wire.h>
#include <SparkFun_MAX1704x_Fuel_Gauge_Arduino_Library.h>
#include "HT_DEPG0290BxS800FxX_BW.h"
#include <Adafruit_LSM6DSOX.h>
#include <driver/rtc_io.h>
#if __has_include("secrets.h")
#include "secrets.h"
#else
#include "secrets.example.h"
#endif

#ifndef FIRMWARE_VERSION_STR
#define FIRMWARE_VERSION_STR "unknown"
#endif
const String FIRMWARE_VERSION = FIRMWARE_VERSION_STR;

// Internet OTA settings.
// Define these in src/secrets.h to enable update checks from a hosted JSON manifest.
#ifndef INTERNET_OTA_MANIFEST_URL
#define INTERNET_OTA_MANIFEST_URL ""
#endif
#ifndef INTERNET_OTA_MIN_BATTERY_PERCENT
#define INTERNET_OTA_MIN_BATTERY_PERCENT 25.0f
#endif
#ifndef INTERNET_OTA_CHECK_ON_TIMER_WAKE
#define INTERNET_OTA_CHECK_ON_TIMER_WAKE 1
#endif

// ================= DISPLAY =================
DEPG0290BxS800FxX_BW display(5, 4, 3, 6, 2, 1, -1, 6000000);

// ================= BATTERY =================
SFE_MAX1704X fuelGauge;

// ================= BUTTON =================
#define WAKE_PIN 17
#define SDA_PIN 39
#define SCL_PIN 38

// ================= LOGO PLACEHOLDER =================
#define LOGO_W 128
#define LOGO_H 128

const unsigned char cj_logo[] PROGMEM = {
   0x00, 0x00, 0x00, 0x00, 0x00, 0x00, 0x00, 0x00, 0x00, 0x00, 0x00, 0x00,
   0x00, 0x00, 0x00, 0x00, 0x00, 0x00, 0x00, 0x00, 0x00, 0x00, 0x00, 0x00,
   0x00, 0x00, 0x00, 0x00, 0x00, 0x00, 0x00, 0x00, 0x00, 0x00, 0x00, 0x00,
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   0x00, 0x00, 0x00, 0x00, 0x00, 0x00, 0x00, 0x00
};

// ================= ORIENTATION =================
Adafruit_LSM6DSOX sox;
int savedRotation = 0;

// ================= MARGINS =================
const int MARGIN_LEFT  = 8;
const int MARGIN_RIGHT = 10;
const int MARGIN_TOP   = 10;
// helper: make WAKE_PIN stable as an EXT1 wake source
static void setupWakePinRTC(gpio_num_t pin) {
  // Route pin through RTC domain (required for reliable EXT1)
  rtc_gpio_deinit(pin);
  rtc_gpio_set_direction(pin, RTC_GPIO_MODE_INPUT_ONLY);

  // Enable RTC pullup so it stays HIGH in deep sleep when reed is open
  rtc_gpio_pullup_en(pin);
  rtc_gpio_pulldown_dis(pin);

  // Hold the RTC configuration through deep sleep
  rtc_gpio_hold_en(pin);
}

// helper: release hold after waking (optional but good practice)
static void releaseWakePinRTC(gpio_num_t pin) {
  rtc_gpio_hold_dis(pin);
}

static bool confirmedLow(uint32_t ms = 60) {
  uint32_t t0 = millis();
  while (millis() - t0 < ms) {
    if (digitalRead(WAKE_PIN) != LOW) return false;
    delay(2);
  }
  return true;
}
// Fake bold helper
void drawStringBold(int x, int y, const String &text) {
  display.drawString(x, y, text);
  display.drawString(x + 1, y, text);
  display.drawString(x, y + 1, text);
  display.drawString(x + 1, y + 1, text);
}

// Heltec Vext
void VextON()  { pinMode(18, OUTPUT); digitalWrite(18, HIGH); }

// ================= OTA =================
// Raw IMU orientation (0/90/180/270) that triggers OTA when reed is LOW
const int OTA_ROTATION = 270;
const uint32_t OTA_WINDOW_MS = 60000; // OTA listen window

// ================= CACHED STATS (RTC) =================
RTC_DATA_ATTR bool hasCache = false;
RTC_DATA_ATTR int cachedDaysUntil = 0;
RTC_DATA_ATTR char cachedDives[8] = "";
RTC_DATA_ATTR char cachedMinutes[16] = "";
RTC_DATA_ATTR char cachedDeepest[16] = "";
RTC_DATA_ATTR char cachedNextDive[64] = "";

// ================= ORIENTATION FUNCTIONS =================
int detectOrientation() {
  sensors_event_t accel;
  sensors_event_t gyro;
  sensors_event_t temp;
  sox.getEvent(&accel, &gyro, &temp);

  if (abs(accel.acceleration.x) > abs(accel.acceleration.y)) {
    if (accel.acceleration.x > 0) return 90;
    else return 270;
  } else {
    if (accel.acceleration.y > 0) return 0;
    else return 180;
  }
}

void applyRotation(int rotation) {
  switch(rotation) {
    case 0:   display.screenRotate(ANGLE_0_DEGREE); break;
    // Never render at 270; map both side rotations to 90
    case 90:  display.screenRotate(ANGLE_90_DEGREE); break;
    case 180: display.screenRotate(ANGLE_180_DEGREE); break;
    case 270: display.screenRotate(ANGLE_90_DEGREE); break;
    default:  display.screenRotate(ANGLE_0_DEGREE); break;
  }
}

// Legacy OTA trigger mapping (preserves previous 270 trigger behavior)
int displayRotationFromRaw(int rotation) {
  switch(rotation) {
    case 0:   return 0;
    case 90:  return 270;
    case 180: return 180;
    case 270: return 90;
    default:  return 0;
  }
}

// ================= BATTERY SCREEN =================
void renderBatteryScreenHorizontal() {
  display.clear();
  display.setTextAlignment(TEXT_ALIGN_CENTER);

  float voltage = fuelGauge.getVoltage();
  float percent = fuelGauge.getSOC();

  display.drawXbm(0, (128 - LOGO_H)/2, LOGO_W, LOGO_H, cj_logo);

  const int rightCenterX = 148 + 74;
  display.setFont(ArialMT_Plain_24);
  display.drawString(rightCenterX, 28, String(percent, 0) + "%");

  display.drawHorizontalLine(148 + 20, 70, 120);

  display.setFont(ArialMT_Plain_16);
  display.drawString(rightCenterX, 82, String(voltage, 2) + " V");

  display.setTextAlignment(TEXT_ALIGN_RIGHT);
  display.setFont(ArialMT_Plain_10);
  display.drawString(296 - MARGIN_RIGHT, 128 - 12, FIRMWARE_VERSION);

  display.display();
}

void renderBatteryScreenVertical() {
  display.clear();
  display.setTextAlignment(TEXT_ALIGN_CENTER);

  float voltage = fuelGauge.getVoltage();
  float percent = fuelGauge.getSOC();

  const int centerX = 128 / 2;
  int y = 8;   // small top margin

  // ---- LOGO ----
  display.drawXbm(
    (128 - LOGO_W) / 2,
    y,
    LOGO_W,
    LOGO_H,
    cj_logo
  );
  y += LOGO_H + 12;  // space after logo

  // ---- LABEL ----
  display.setFont(ArialMT_Plain_16);
  display.drawString(centerX, y, "Battery");
  y += 22;

  // ---- PERCENT ----
  display.setFont(ArialMT_Plain_24);
  drawStringBold(centerX, y, String(percent, 0) + "%");
  y += 34;

  // ---- VOLTAGE ----
  display.setFont(ArialMT_Plain_16);
  display.drawString(centerX, y, String(voltage, 2) + " V");
  y += 32;

  // ---- VERSION ----
  display.setFont(ArialMT_Plain_10);
  display.drawString(centerX, 296 - 16, FIRMWARE_VERSION);

  display.display();
}

void showBatteryScreenHorizontal() {
  renderBatteryScreenHorizontal();
  delay(5000);
}

void showBatteryScreenVertical() {
  renderBatteryScreenVertical();
  delay(5000);
}



// ================= MAIN DISPLAY =================
void showStats(const String& dives,
               const String& minutes,
               const String& deepest,
               int daysUntil,
               const String& nextDive) {
  display.clear();
  display.setFont(ArialMT_Plain_16);

  const int screenW = 296;
  const int innerW = screenW - MARGIN_LEFT - MARGIN_RIGHT;
  const int centerX = MARGIN_LEFT + (innerW / 2);

  display.setTextAlignment(TEXT_ALIGN_LEFT);
  drawStringBold(MARGIN_LEFT, MARGIN_TOP, dives + " Dives Total");

  display.setTextAlignment(TEXT_ALIGN_RIGHT);
  drawStringBold(screenW - MARGIN_RIGHT, MARGIN_TOP,
                 "Deepest Dive: " + deepest + " ");

  display.setTextAlignment(TEXT_ALIGN_CENTER);
  drawStringBold(centerX, MARGIN_TOP + 30,
                 "Spent " + minutes + " Underwater");

  const int gapW = 140;
  const int yLine = MARGIN_TOP + 70;

  display.drawHorizontalLine(MARGIN_LEFT, yLine, centerX - gapW / 2 - MARGIN_LEFT);
  display.drawHorizontalLine(centerX + gapW / 2, yLine,
                             (screenW - MARGIN_RIGHT) - (centerX + gapW / 2));

  drawStringBold(centerX, yLine - 9, "Next dive in:");

  String nextLine = String(daysUntil) + " days  -  " + nextDive;
  if (nextLine.length() > 36) nextLine = nextLine.substring(0,33) + "...";

  drawStringBold(centerX, yLine + 14, nextLine);

  display.display();
}

void showStatsVertical(const String& dives,
                       const String& minutes,
                       const String& deepest,
                       int daysUntil,
                       const String& nextDive)
{
  display.clear();

  const int centerX = 128 / 2;   // vertical screen width
  int y = 35;

  display.setTextAlignment(TEXT_ALIGN_CENTER);

  // ---------- TOTAL DIVES ----------
  display.setFont(ArialMT_Plain_16);
  display.drawString(centerX, y, "Total Dives");
  y += 20;

  display.setFont(ArialMT_Plain_24);
  drawStringBold(centerX, y, dives);
  y += 36;

  // ---------- DEEPEST DIVE ----------
  display.setFont(ArialMT_Plain_16);
  display.drawString(centerX, y, "Deepest Dive");
  y += 20;

  display.setFont(ArialMT_Plain_24);
  drawStringBold(centerX, y, deepest);
  y += 36;

  // ---------- UNDERWATER ----------
  display.setFont(ArialMT_Plain_16);
  display.drawString(centerX, y, "Time Underwater");
  y += 20;

  display.setFont(ArialMT_Plain_24);
  drawStringBold(centerX, y, minutes);
  y += 36;

  // ---------- NEXT DIVE ----------
  display.setFont(ArialMT_Plain_16);
  display.drawString(centerX, y, "Next Dive In");
  y += 20;

  display.setFont(ArialMT_Plain_24);
  drawStringBold(centerX, y, String(daysUntil) + " days");

  display.display();
}

// ================= CACHE HELPERS =================
void updateCacheFromJson(const JsonDocument& doc) {
  String dives = String(doc["totalDives"].as<int>());
  String minutes = doc["totalMinutesUnderwater"].as<String>();
  String deepest = doc["deepestDive"].as<String>();
  String nextDive = doc["nextDive"].as<String>();

  cachedDaysUntil = doc["daysUntil"] | 0;

  snprintf(cachedDives, sizeof(cachedDives), "%s", dives.c_str());
  snprintf(cachedMinutes, sizeof(cachedMinutes), "%s", minutes.c_str());
  snprintf(cachedDeepest, sizeof(cachedDeepest), "%s", deepest.c_str());
  snprintf(cachedNextDive, sizeof(cachedNextDive), "%s", nextDive.c_str());

  hasCache = true;
}

bool showCachedStats() {
  if (!hasCache) return false;

  if (savedRotation == 0 || savedRotation == 180)
    showStats(
      String(cachedDives),
      String(cachedMinutes),
      String(cachedDeepest),
      cachedDaysUntil,
      String(cachedNextDive)
    );
  else
    showStatsVertical(
      String(cachedDives),
      String(cachedMinutes),
      String(cachedDeepest),
      cachedDaysUntil,
      String(cachedNextDive)
    );

  return true;
}

// ================= INTERNET OTA =================
bool internetOtaConfigured() {
  return strlen(INTERNET_OTA_MANIFEST_URL) > 0;
}

bool fetchInternetOtaManifest(String& version, String& binUrl) {
  if (!internetOtaConfigured()) return false;

  WiFiClientSecure client;
  client.setInsecure();
  HTTPClient http;

  if (!http.begin(client, INTERNET_OTA_MANIFEST_URL)) return false;

  int code = http.GET();
  if (code != HTTP_CODE_OK) {
    Serial.printf("Internet OTA manifest HTTP error: %d\n", code);
    http.end();
    return false;
  }

  StaticJsonDocument<1024> doc;
  DeserializationError err = deserializeJson(doc, http.getString());
  http.end();
  if (err) {
    Serial.printf("Internet OTA manifest parse error: %s\n", err.c_str());
    return false;
  }

  version = doc["version"] | "";
  binUrl = doc["bin_url"] | doc["binUrl"] | doc["firmware_url"] | doc["firmwareUrl"] | doc["firmware"] | "";
  version.trim();
  binUrl.trim();

  if (version.length() == 0 || binUrl.length() == 0) {
    Serial.println("Internet OTA manifest missing version or bin URL");
    return false;
  }

  return true;
}

bool applyInternetOta(const String& targetVersion, const String& binUrl) {
  WiFiClientSecure client;
  client.setInsecure();

  httpUpdate.rebootOnUpdate(true);
  httpUpdate.setFollowRedirects(HTTPC_FORCE_FOLLOW_REDIRECTS);

  Serial.printf("Internet OTA applying %s -> %s\n", FIRMWARE_VERSION.c_str(), targetVersion.c_str());
  Serial.printf("Internet OTA URL: %s\n", binUrl.c_str());

  t_httpUpdate_return result = httpUpdate.update(client, binUrl, FIRMWARE_VERSION);

  if (result == HTTP_UPDATE_OK) {
    Serial.println("Internet OTA update applied");
    return true;
  }

  if (result == HTTP_UPDATE_NO_UPDATES) {
    Serial.println("Internet OTA reports no updates");
    return false;
  }

  Serial.printf(
    "Internet OTA failed (%d): %s\n",
    httpUpdate.getLastError(),
    httpUpdate.getLastErrorString().c_str()
  );
  return false;
}

bool checkAndApplyInternetOta() {
  if (!internetOtaConfigured()) return false;

  float battery = fuelGauge.getSOC();
  if (battery >= 0.0f && battery < INTERNET_OTA_MIN_BATTERY_PERCENT) {
    Serial.printf(
      "Internet OTA skipped: battery %.1f%% below %.1f%%\n",
      battery,
      INTERNET_OTA_MIN_BATTERY_PERCENT
    );
    return false;
  }

  String targetVersion;
  String binUrl;
  if (!fetchInternetOtaManifest(targetVersion, binUrl)) return false;

  if (targetVersion == FIRMWARE_VERSION) {
    Serial.println("Internet OTA: already on latest version");
    return false;
  }

  return applyInternetOta(targetVersion, binUrl);
}

// ================= WIFI =================
bool connectWiFi() {
  for (int i = 0; i < WIFI_COUNT; i++) {
    WiFi.begin(wifiList[i][0], wifiList[i][1]);
    int tries = 0;
    while (WiFi.status() != WL_CONNECTED && tries < 30) {
      delay(250);
      tries++;
    }
    if (WiFi.status() == WL_CONNECTED) return true;
  }
  return false;
}

bool fetchAndUpdateCache(bool forceRefresh) {
  WiFiClientSecure client;
  client.setInsecure();
  HTTPClient http;

  String url = String(JSON_URL);
  if (forceRefresh) {
    url += (url.indexOf('?') >= 0) ? "&refresh=1" : "?refresh=1";
  }
  if (!http.begin(client, url)) return false;

  int code = http.GET();
  if (code <= 0) {
    http.end();
    return false;
  }

  StaticJsonDocument<1024> doc;
  DeserializationError err = deserializeJson(doc, http.getString());
  http.end();

  if (err) return false;

  updateCacheFromJson(doc);
  return true;
}

// ================= OTA =================
void showOtaBatteryScreen(bool horizontal, const String &ip) {
  if (horizontal)
    renderBatteryScreenHorizontal();
  else
    renderBatteryScreenVertical();

  display.setTextAlignment(TEXT_ALIGN_CENTER);
  display.setFont(ArialMT_Plain_10);

  if (horizontal) {
    display.drawString(296 / 2, 108, "IP: " + ip);
  } else {
    display.drawString(128 / 2, 264, "IP: " + ip);
  }

  display.display();
}

void enterOtaMode() {
  if (!connectWiFi()) {
    display.clear();
    display.setTextAlignment(TEXT_ALIGN_CENTER);
    display.setFont(ArialMT_Plain_16);
    display.drawString(296 / 2, 50, "WiFi Failed");
    display.drawString(296 / 2, 70, "OTA Aborted");
    display.display();
    delay(2000);
    return;
  }

  // Update cached stats during OTA mode (force refresh)
  fetchAndUpdateCache(true);

  // Check internet OTA manifest and update automatically if a newer version exists.
  // If update is applied successfully, the device will reboot.
  checkAndApplyInternetOta();

  ArduinoOTA.setHostname(OTA_HOSTNAME);
  if (OTA_PASSWORD && OTA_PASSWORD[0] != '\0') {
    ArduinoOTA.setPassword(OTA_PASSWORD);
  }

  ArduinoOTA.onStart([]() { Serial.println("OTA Start"); });
  ArduinoOTA.onEnd([]() { Serial.println("OTA End"); });
  ArduinoOTA.onError([](ota_error_t error) {
    Serial.printf("OTA Error[%u]\n", error);
  });

  ArduinoOTA.begin();

  const bool horizontal = (savedRotation == 0 || savedRotation == 180);
  showOtaBatteryScreen(horizontal, WiFi.localIP().toString());

  uint32_t start = millis();
  while (millis() - start < OTA_WINDOW_MS) {
    ArduinoOTA.handle();
    delay(10);
  }

  // OTA window expired -> reboot instead of sleeping
  ESP.restart();
}

// ================= SETUP =================
void setup() {
  Serial.begin(115200);
  delay(200);

  // Release hold in case we held it before sleep
  releaseWakePinRTC((gpio_num_t)WAKE_PIN);

  // Normal GPIO mode while running
  pinMode(WAKE_PIN, INPUT_PULLUP);

  VextON();
  delay(50);

  display.init();
  display.screenRotate(ANGLE_0_DEGREE);

  // IMPORTANT: start I2C once, on your chosen pins, before any I2C devices begin()
  Wire.begin(SDA_PIN, SCL_PIN);
  delay(20);

  fuelGauge.begin();

  if (!sox.begin_I2C()) {
    Serial.println("IMU not found!");
  }

  savedRotation = detectOrientation();
  applyRotation(savedRotation);

  // Wake cause
  esp_sleep_wakeup_cause_t cause = esp_sleep_get_wakeup_cause();
  Serial.print("Wake cause: ");
  Serial.println((int)cause);

  bool reedLow = (digitalRead(WAKE_PIN) == LOW && confirmedLow());
  bool didOta = false;
  bool timerWake = (cause == ESP_SLEEP_WAKEUP_TIMER);

  if (reedLow) {
    // Give a short window to rotate into OTA orientation
    uint32_t t0 = millis();
    while (millis() - t0 < 1500) {
      int rot = detectOrientation();
      int otaRot = displayRotationFromRaw(rot);
      if (otaRot == OTA_ROTATION) {
        savedRotation = rot;
        applyRotation(savedRotation);
        Serial.println("Reed LOW + OTA mapped rotation -> OTA mode");
        enterOtaMode();
        didOta = true;
        break;
      }
      delay(50);
    }

    if (!didOta) {
      savedRotation = detectOrientation();
      applyRotation(savedRotation);
      showCachedStats();
      Serial.println("Reed LOW -> Sleep");
    }

    // Wait until magnet removed so we don't immediately wake again
    Serial.println("Waiting for reed release...");
    while (digitalRead(WAKE_PIN) == LOW) delay(10);
    delay(80); // debounce settle
  }

  if (!reedLow) {
    // ---- normal main flow ----
    bool shouldRefresh = timerWake || !hasCache;
    if (shouldRefresh) {
      if (!connectWiFi()) {
        display.clear();
        drawStringBold(MARGIN_LEFT, MARGIN_TOP, "WiFi Failed");
        display.display();
        delay(2000);
      } else {
#if INTERNET_OTA_CHECK_ON_TIMER_WAKE
        if (timerWake) {
          // Daily wake checks GitHub manifest for a newer firmware.
          // Successful update reboots before continuing.
          checkAndApplyInternetOta();
        }
#endif
        if (!fetchAndUpdateCache(true)) {
          // fall back to cached data if refresh fails
          showCachedStats();
        } else {
          showCachedStats();
        }
      }
    } else {
      showCachedStats();
    }

    delay(2000);
  }

  // ---- configure wake sources just before sleeping ----
  esp_sleep_disable_wakeup_source(ESP_SLEEP_WAKEUP_ALL);

  // Make WAKE_PIN stable for deep sleep + EXT1
  setupWakePinRTC((gpio_num_t)WAKE_PIN);

  // Wake when reed closes (LOW)
  esp_sleep_enable_ext1_wakeup(1ULL << WAKE_PIN, ESP_EXT1_WAKEUP_ALL_LOW);

  // Optional: daily refresh
  esp_sleep_enable_timer_wakeup(24ULL * 60ULL * 60ULL * 1000000ULL);

  Serial.print("Going to sleep. WAKE_PIN=");
  Serial.print(WAKE_PIN);
  Serial.print(" state=");
  Serial.println(digitalRead(WAKE_PIN));

  Serial.flush();
  delay(50);
  esp_deep_sleep_start();
}

void loop() {}
